## boards/shields/thewolfkb/Kconfig.defconfig
```kconfig
if SHIELD_THEWOLFKB50_LEFT

config ZMK_KEYBOARD_NAME
    default "thewolfkb50"

config ZMK_SPLIT_ROLE_CENTRAL
    default y

endif

if SHIELD_THEWOLFKB50_LEFT || SHIELD_THEWOLFKB50_RIGHT

config ZMK_SPLIT
    default y

endif
```

## boards/shields/thewolfkb50/Kconfig.shield
```kconfig
# Copyright (c) 2020 The ZMK Contributors
# SPDX-License-Identifier: MIT

config SHIELD_THEWOLFKB50_LEFT
    def_bool $(shields_list_contains,thewolfkb50_left)

config SHIELD_THEWOLFKB50_RIGHT
    def_bool $(shields_list_contains,thewolfkb50_right)
```
